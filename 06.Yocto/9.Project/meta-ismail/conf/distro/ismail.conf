## 06.Yocto/9.Project/meta-ismail/conf/distro/ismail.conf
```bitbake
MAINTAINER = "ismail <ismailelghawas12@gmail.com>"
require conf/distro/poky.conf

DISTRO = "ismail"
DISTRO_VERSION = "1.0"
DISTRO_NAME = "Ismail is awesome"
DISTRO_FEATURES:remove = "x11 wayland ptest alsa nfc seccomp pcmcia "
INIT_MANAGER = "systemd"
DISTRO_FEATURES:append = " wifi bluetooth"
```

## 06.Yocto/9.Project/meta-ismail/conf/layer.conf
```bitbake
# We have a conf and classes directory, add to BBPATH
BBPATH .= ":${LAYERDIR}"

# We have recipes-* directories, add to BBFILES
BBFILES += "${LAYERDIR}/recipes-*/*/*.bb \
            ${LAYERDIR}/recipes-*/*/*.bbappend"

BBFILE_COLLECTIONS += "meta-ismail"
BBFILE_PATTERN_meta-ismail = "^${LAYERDIR}/"
BBFILE_PRIORITY_meta-ismail = "6"

LAYERDEPENDS_meta-ismail = "core"
LAYERSERIES_COMPAT_meta-ismail = "kirkstone"
```

## 06.Yocto/9.Project/meta-ismail/conf/machine/ismail-machine.conf
```bitbake
MACHINEOVERRIDES =. "raspberrypi4-64:${MACHINE}"
require conf/machine/raspberrypi4-64.conf
ENABLE_UART = "1"
RPI_USE_U_BOOT = "1"
PREFERRED_PROVIDER_virtual/bootloader = "u-boot"
```
